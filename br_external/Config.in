## br_external/Config.in
```kconfig
source "$BR2_EXTERNAL_QEMU_KERNEL_DEV_PATH/package/foo/Config.in"
source "$BR2_EXTERNAL_QEMU_KERNEL_DEV_PATH/package/snull/Config.in"
```

## br_external/configs/qemu_x86_defconfig
```kconfig
BR2_x86_64=y
BR2_PACKAGE_GLIBC_UTILS=y
BR2_TOOLCHAIN_BUILDROOT_CXX=y
BR2_PACKAGE_HOST_GDB=y
BR2_PACKAGE_HOST_GDB_TUI=y
BR2_PACKAGE_HOST_GDB_PYTHON3=y
BR2_ROOTFS_DEVICE_TABLE="$(BR2_EXTERNAL)/board/qemu_x86/device_table.txt"
BR2_ROOTFS_OVERLAY="$(BR2_EXTERNAL)/board/qemu_x86/overlay"
BR2_ROOTFS_POST_BUILD_SCRIPT="$(BR2_EXTERNAL)/board/qemu_x86/post-build.sh"
BR2_LINUX_KERNEL=y
BR2_LINUX_KERNEL_USE_CUSTOM_CONFIG=y
BR2_LINUX_KERNEL_CUSTOM_CONFIG_FILE="$(BR2_EXTERNAL)/board/qemu_x86/linux.defconfig"
BR2_LINUX_KERNEL_NEEDS_HOST_OPENSSL=y
BR2_LINUX_KERNEL_NEEDS_HOST_LIBELF=y
BR2_PACKAGE_BUSYBOX_CONFIG="$(BR2_EXTERNAL)/board/qemu_x86/busybox.config"
BR2_PACKAGE_BUSYBOX_SHOW_OTHERS=y
BR2_PACKAGE_BUSYBOX_WATCHDOG=y
BR2_PACKAGE_ETHTOOL=y
BR2_PACKAGE_IFUPDOWN=y
BR2_PACKAGE_NETCAT=y
BR2_PACKAGE_OPENSSH=y
BR2_PACKAGE_BASH=y
BR2_PACKAGE_KMOD=y
BR2_PACKAGE_KMOD_TOOLS=y
BR2_PACKAGE_LESS=y
BR2_PACKAGE_NANO=y
BR2_TARGET_ROOTFS_CPIO=y
BR2_TARGET_ROOTFS_CPIO_GZIP=y
BR2_PACKAGE_HOST_ENVIRONMENT_SETUP=y
BR2_PACKAGE_HOST_MKPASSWD=y
BR2_PACKAGE_FOO=y
```

## br_external/package/snull/Config.in
```kconfig
config BR2_PACKAGE_SNULL_DRIVER
    bool "Snull driver"
    help
        "Snull driver"
```
